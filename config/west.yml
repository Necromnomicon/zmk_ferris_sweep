## config/west.yml
```yaml
#Urob's Firmware with additonal pull requests
manifest:
  remotes:
    - name: zmkfirmware
      url-base: https://github.com/zmkfirmware
    - name: urob
      url-base: https://github.com/urob
  projects:
    - name: zmk
      remote: urob
      revision: main
      import: app/west.yml
  self:
    path: config






# Original firmware 
#manifest:
# remotes:
#   - name: zmkfirmware
#     url-base: https://github.com/zmkfirmware
#projects:
#   - name: zmk
#    remote: zmkfirmware
#     revision: main
#     import: app/west.yml
 # self:
 #   path: config
#
```
